/******************************************************************************
* ASAP2 file: E33_VCU_simulink.a2l
* Code generation for model "E33_VCU_simulink".
* Model version : 1.70
* Simulink Coder version : 8.6 (R2014a) 27-Dec-2013
* C source code generated on : Sun Nov 26 16:56:12 2023
* Target selection: ec55xx.tlc
* Embedded hardware selection: Freescale MPC5500
* Code generation objectives: Unspecified
* Validation result: Not run
* (add additional file header information here)
******************************************************************************/ ASAP2_VERSION 1 31
/* Version 1.31 */
/begin PROJECT ECUCoderProject "ECUCoder Project"
/begin HEADER "Header Comments go here" /end HEADER
/begin MODULE ModuleName "No Comment"
/begin MOD_PAR "No Comment" /end MOD_PAR
/begin MOD_COMMON "No Comment" BYTE_ORDER MSB_FIRST /end MOD_COMMON
/begin RECORD_LAYOUT Scalar_BOOLEAN FNC_VALUES 1 UBYTE COLUMN_DIR DIRECT /end RECORD_LAYOUT
/begin RECORD_LAYOUT Scalar_UBYTE FNC_VALUES 1 UBYTE COLUMN_DIR DIRECT /end RECORD_LAYOUT
/begin RECORD_LAYOUT Scalar_BYTE FNC_VALUES 1 SBYTE COLUMN_DIR DIRECT /end RECORD_LAYOUT
/begin RECORD_LAYOUT Scalar_UWORD FNC_VALUES 1 UWORD COLUMN_DIR DIRECT /end RECORD_LAYOUT
/begin RECORD_LAYOUT Scalar_SWORD FNC_VALUES 1 SWORD COLUMN_DIR DIRECT /end RECORD_LAYOUT
/begin RECORD_LAYOUT Scalar_ULONG FNC_VALUES 1 ULONG COLUMN_DIR DIRECT /end RECORD_LAYOUT
/begin RECORD_LAYOUT Scalar_LONG FNC_VALUES 1 SLONG COLUMN_DIR DIRECT /end RECORD_LAYOUT
/begin RECORD_LAYOUT Scalar_FLOAT32_IEEE FNC_VALUES 1 FLOAT32_IEEE COLUMN_DIR DIRECT /end RECORD_LAYOUT
/begin RECORD_LAYOUT Scalar_FLOAT64_IEEE FNC_VALUES 1 FLOAT64_IEEE COLUMN_DIR DIRECT /end RECORD_LAYOUT
/begin RECORD_LAYOUT Lookup1D_BYTE FNC_VALUES 1 SBYTE COLUMN_DIR DIRECT /end RECORD_LAYOUT
/begin RECORD_LAYOUT Lookup1D_X_BYTE AXIS_PTS_X 1 SBYTE INDEX_INCR DIRECT /end RECORD_LAYOUT
/begin RECORD_LAYOUT Lookup1D_UBYTE FNC_VALUES 1 UBYTE COLUMN_DIR DIRECT /end RECORD_LAYOUT
/begin RECORD_LAYOUT Lookup1D_X_UBYTE AXIS_PTS_X 1 UBYTE INDEX_INCR DIRECT /end RECORD_LAYOUT
/begin RECORD_LAYOUT Lookup1D_UWORD FNC_VALUES 1 UWORD COLUMN_DIR DIRECT /end RECORD_LAYOUT
/begin RECORD_LAYOUT Lookup1D_X_UWORD AXIS_PTS_X 1 UWORD INDEX_INCR DIRECT /end RECORD_LAYOUT
/begin RECORD_LAYOUT Lookup1D_WORD FNC_VALUES 1 SWORD COLUMN_DIR DIRECT /end RECORD_LAYOUT
/begin RECORD_LAYOUT Lookup1D_X_WORD AXIS_PTS_X 1 SWORD INDEX_INCR DIRECT /end RECORD_LAYOUT
/begin RECORD_LAYOUT Lookup1D_ULONG FNC_VALUES 1 ULONG COLUMN_DIR DIRECT /end RECORD_LAYOUT
/begin RECORD_LAYOUT Lookup1D_X_ULONG AXIS_PTS_X 1 ULONG INDEX_INCR DIRECT /end RECORD_LAYOUT
/begin RECORD_LAYOUT Lookup1D_SLONG FNC_VALUES 1 SLONG COLUMN_DIR DIRECT /end RECORD_LAYOUT
/begin RECORD_LAYOUT Lookup1D_X_LONG AXIS_PTS_X 1 SLONG INDEX_INCR DIRECT /end RECORD_LAYOUT
/begin RECORD_LAYOUT Lookup1D_FLOAT32_IEEE FNC_VALUES 1 FLOAT32_IEEE COLUMN_DIR DIRECT /end RECORD_LAYOUT
/begin RECORD_LAYOUT Lookup1D_X_FLOAT32_IEEE AXIS_PTS_X 1 FLOAT32_IEEE INDEX_INCR DIRECT /end RECORD_LAYOUT
/begin RECORD_LAYOUT Lookup1D_FLOAT64_IEEE FNC_VALUES 1 FLOAT64_IEEE COLUMN_DIR DIRECT /end RECORD_LAYOUT
/begin RECORD_LAYOUT Lookup1D_X_FLOAT64_IEEE AXIS_PTS_X 1 FLOAT64_IEEE INDEX_INCR DIRECT /end RECORD_LAYOUT
/begin RECORD_LAYOUT Lookup2D_UBYTE FNC_VALUES 1 UBYTE COLUMN_DIR DIRECT /end RECORD_LAYOUT
/begin RECORD_LAYOUT Lookup2D_X_UBYTE AXIS_PTS_X 1 UBYTE INDEX_INCR DIRECT /end RECORD_LAYOUT
/begin RECORD_LAYOUT Lookup2D_BYTE FNC_VALUES 1 SBYTE COLUMN_DIR DIRECT /end RECORD_LAYOUT
/begin RECORD_LAYOUT Lookup2D_X_BYTE AXIS_PTS_X 1 SBYTE INDEX_INCR DIRECT /end RECORD_LAYOUT
/begin RECORD_LAYOUT Lookup2D_UWORD FNC_VALUES 1 UWORD COLUMN_DIR DIRECT /end RECORD_LAYOUT
/begin RECORD_LAYOUT Lookup2D_X_UWORD AXIS_PTS_X 1 UWORD INDEX_INCR DIRECT /end RECORD_LAYOUT
/begin RECORD_LAYOUT Lookup2D_WORD FNC_VALUES 1 SWORD COLUMN_DIR DIRECT /end RECORD_LAYOUT
/begin RECORD_LAYOUT Lookup2D_X_WORD AXIS_PTS_X 1 SWORD INDEX_INCR DIRECT /end RECORD_LAYOUT
/begin RECORD_LAYOUT Lookup2D_ULONG FNC_VALUES 1 ULONG COLUMN_DIR DIRECT /end RECORD_LAYOUT
/begin RECORD_LAYOUT Lookup2D_X_ULONG AXIS_PTS_X 1 ULONG INDEX_INCR DIRECT /end RECORD_LAYOUT
/begin RECORD_LAYOUT Lookup2D_LONG FNC_VALUES 1 SLONG COLUMN_DIR DIRECT /end RECORD_LAYOUT
/begin RECORD_LAYOUT Lookup2D_X_LONG AXIS_PTS_X 1 SLONG INDEX_INCR DIRECT /end RECORD_LAYOUT
/begin RECORD_LAYOUT Lookup2D_FLOAT32_IEEE FNC_VALUES 1 FLOAT32_IEEE COLUMN_DIR DIRECT /end RECORD_LAYOUT
/begin RECORD_LAYOUT Lookup2D_X_FLOAT32_IEEE AXIS_PTS_X 1 FLOAT32_IEEE INDEX_INCR DIRECT /end RECORD_LAYOUT
/begin RECORD_LAYOUT Lookup2D_FLOAT64_IEEE FNC_VALUES 1 FLOAT64_IEEE COLUMN_DIR DIRECT /end RECORD_LAYOUT
/begin RECORD_LAYOUT Lookup2D_X_FLOAT64_IEEE AXIS_PTS_X 1 FLOAT64_IEEE INDEX_INCR DIRECT /end RECORD_LAYOUT
/begin CHARACTERISTIC linear_Map "" /* Characteristic Type */ CURVE @MemoryAddress@linear_Map@ Lookup1D_UWORD /* Maxdiff */ 0 E33_VCU_simulink_CM_uint16 0 65535
 /begin AXIS_DESCR /* Description of X-Axis Points */ /* Axis Type */ COM_AXIS /* Reference to Input */ NO_INPUT_QUANTITY E33_VCU_simulink_CM_uint16 /* Number of Axis Pts */ 2 0 65535 AXIS_PTS_REF linear_RR_Map /end AXIS_DESCR
/end CHARACTERISTIC
/begin AXIS_PTS linear_RR_Map "" /* Memory Adress */ @MemoryAddress@linear_RR_Map@ /* Input Quantity */ NO_INPUT_QUANTITY Lookup1D_X_UWORD 0 E33_VCU_simulink_CM_uint16 /* Number of Axis Pts */ 2 0 65535 /end AXIS_PTS
/begin CHARACTERISTIC Beep_Time "" VALUE @MemoryAddress@Beep_Time@ Scalar_FLOAT64_IEEE 0 E33_VCU_simulink_CM_double -1.7E+308 1.7E+308 /end CHARACTERISTIC
/begin CHARACTERISTIC Brk_luminance "" VALUE @MemoryAddress@Brk_luminance@ Scalar_FLOAT64_IEEE 0 E33_VCU_simulink_CM_double -1.7E+308 1.7E+308 /end CHARACTERISTIC
/begin CHARACTERISTIC FactoryTestEnable "" VALUE @MemoryAddress@FactoryTestEnable@ Scalar_FLOAT64_IEEE 0 E33_VCU_simulink_CM_double -1.7E+308 1.7E+308 /end CHARACTERISTIC
/begin CHARACTERISTIC HardBrk_luminance "" VALUE @MemoryAddress@HardBrk_luminance@ Scalar_FLOAT64_IEEE 0 E33_VCU_simulink_CM_double -1.7E+308 1.7E+308 /end CHARACTERISTIC
/begin CHARACTERISTIC Accu_FAN_threshold "" VAL_BLK @MemoryAddress@Accu_FAN_threshold@ Scalar_FLOAT32_IEEE 0 E33_VCU_simulink_CM_single -3.4E+38 3.4E+38 NUMBER 2 /end CHARACTERISTIC
/begin CHARACTERISTIC Pump_threshold "" VALUE @MemoryAddress@Pump_threshold@ Scalar_FLOAT32_IEEE 0 E33_VCU_simulink_CM_single -3.4E+38 3.4E+38 /end CHARACTERISTIC
/begin CHARACTERISTIC Accu_FAN_Test "" VALUE @MemoryAddress@Accu_FAN_Test@ Scalar_ULONG 0 E33_VCU_simulink_CM_uint32 0 0xFFFFFFFF /end CHARACTERISTIC
/begin CHARACTERISTIC Radiator_FAN_Test "" VALUE @MemoryAddress@Radiator_FAN_Test@ Scalar_ULONG 0 E33_VCU_simulink_CM_uint32 0 0xFFFFFFFF /end CHARACTERISTIC
/begin CHARACTERISTIC Tail_Light_Test "" VALUE @MemoryAddress@Tail_Light_Test@ Scalar_ULONG 0 E33_VCU_simulink_CM_uint32 0 0xFFFFFFFF /end CHARACTERISTIC
/begin CHARACTERISTIC APPS_threshold "" VALUE @MemoryAddress@APPS_threshold@ Scalar_ULONG 0 E33_VCU_simulink_CM_ufix32_En16 0 65535.999984741211 /end CHARACTERISTIC
/begin CHARACTERISTIC APPS1_Voltage "" VAL_BLK @MemoryAddress@APPS1_Voltage@ Scalar_UWORD 0 E33_VCU_simulink_CM_uint16 0 65535 NUMBER 2 /end CHARACTERISTIC
/begin CHARACTERISTIC APPS2_Voltage "" VAL_BLK @MemoryAddress@APPS2_Voltage@ Scalar_UWORD 0 E33_VCU_simulink_CM_uint16 0 65535 NUMBER 2 /end CHARACTERISTIC
/begin CHARACTERISTIC BP_F_Voltage "" VAL_BLK @MemoryAddress@BP_F_Voltage@ Scalar_UWORD 0 E33_VCU_simulink_CM_uint16 0 65535 NUMBER 2 /end CHARACTERISTIC
/begin CHARACTERISTIC BP_F_threshold "" VALUE @MemoryAddress@BP_F_threshold@ Scalar_UWORD 0 E33_VCU_simulink_CM_uint16 0 65535 /end CHARACTERISTIC
/begin CHARACTERISTIC BP_R_Voltage "" VAL_BLK @MemoryAddress@BP_R_Voltage@ Scalar_UWORD 0 E33_VCU_simulink_CM_uint16 0 65535 NUMBER 2 /end CHARACTERISTIC
/begin CHARACTERISTIC MaxRPMchangePerSec "" VALUE @MemoryAddress@MaxRPMchangePerSec@ Scalar_UWORD 0 E33_VCU_simulink_CM_uint16 0 65535 /end CHARACTERISTIC
/begin CHARACTERISTIC MaxTorqChangePerSec "" VALUE @MemoryAddress@MaxTorqChangePerSec@ Scalar_UWORD 0 E33_VCU_simulink_CM_uint16 0 65535 /end CHARACTERISTIC
/begin CHARACTERISTIC SCS_Error_5V "" VALUE @MemoryAddress@SCS_Error_5V@ Scalar_UWORD 0 E33_VCU_simulink_CM_uint16 0 65535 /end CHARACTERISTIC
/begin CHARACTERISTIC SCS_Error_GND "" VALUE @MemoryAddress@SCS_Error_GND@ Scalar_UWORD 0 E33_VCU_simulink_CM_uint16 0 65535 /end CHARACTERISTIC
/begin CHARACTERISTIC linear_FL_Map "" VAL_BLK @MemoryAddress@linear_FL_Map@ Scalar_UWORD 0 E33_VCU_simulink_CM_uint16 0 65535 NUMBER 2 /end CHARACTERISTIC
/begin CHARACTERISTIC linear_FR_Map "" VAL_BLK @MemoryAddress@linear_FR_Map@ Scalar_UWORD 0 E33_VCU_simulink_CM_uint16 0 65535 NUMBER 2 /end CHARACTERISTIC
/begin CHARACTERISTIC linear_RL_Map "" VAL_BLK @MemoryAddress@linear_RL_Map@ Scalar_UWORD 0 E33_VCU_simulink_CM_uint16 0 65535 NUMBER 2 /end CHARACTERISTIC
/begin CHARACTERISTIC BMSLedTest "" VALUE @MemoryAddress@BMSLedTest@ Scalar_BOOLEAN 0 E33_VCU_simulink_CM_boolean 0 1 /end CHARACTERISTIC
/begin CHARACTERISTIC BeeperTest "" VALUE @MemoryAddress@BeeperTest@ Scalar_BOOLEAN 0 E33_VCU_simulink_CM_boolean 0 1 /end CHARACTERISTIC
/begin CHARACTERISTIC DCDC_Relay_Test "" VALUE @MemoryAddress@DCDC_Relay_Test@ Scalar_BOOLEAN 0 E33_VCU_simulink_CM_boolean 0 1 /end CHARACTERISTIC
/begin CHARACTERISTIC IMDLedTest "" VALUE @MemoryAddress@IMDLedTest@ Scalar_BOOLEAN 0 E33_VCU_simulink_CM_boolean 0 1 /end CHARACTERISTIC
/begin CHARACTERISTIC Pump_Test "" VALUE @MemoryAddress@Pump_Test@ Scalar_BOOLEAN 0 E33_VCU_simulink_CM_boolean 0 1 /end CHARACTERISTIC
/begin CHARACTERISTIC R2D_Light_Test "" VALUE @MemoryAddress@R2D_Light_Test@ Scalar_BOOLEAN 0 E33_VCU_simulink_CM_boolean 0 1 /end CHARACTERISTIC
/begin MEASUREMENT MCU_HvVolt "" FLOAT32_IEEE E33_VCU_simulink_CM_single 0 0 -3.4E+38 3.4E+38 ECU_ADDRESS @MemoryAddress@MCU_HvVolt@ /end MEASUREMENT
/begin MEASUREMENT MaxTemp "" FLOAT32_IEEE E33_VCU_simulink_CM_single 0 0 -3.4E+38 3.4E+38 ECU_ADDRESS @MemoryAddress@MaxTemp@ /end MEASUREMENT
/begin MEASUREMENT BMS_AlmLv "" FLOAT32_IEEE E33_VCU_simulink_CM_single 0 0 -3.4E+38 3.4E+38 ECU_ADDRESS @MemoryAddress@BMS_AlmLv@ /end MEASUREMENT
/begin MEASUREMENT BMS_Current "" FLOAT32_IEEE E33_VCU_simulink_CM_single 0 0 -3.4E+38 3.4E+38 ECU_ADDRESS @MemoryAddress@BMS_Current@ /end MEASUREMENT
/begin MEASUREMENT BMS_SoC "" FLOAT32_IEEE E33_VCU_simulink_CM_single 0 0 -3.4E+38 3.4E+38 ECU_ADDRESS @MemoryAddress@BMS_SoC@ /end MEASUREMENT
/begin MEASUREMENT BMS_Voltage "" FLOAT32_IEEE E33_VCU_simulink_CM_single 0 0 -3.4E+38 3.4E+38 ECU_ADDRESS @MemoryAddress@BMS_Voltage@ /end MEASUREMENT
/begin MEASUREMENT Pwr_Lim "" FLOAT32_IEEE E33_VCU_simulink_CM_single 0 0 -3.4E+38 3.4E+38 ECU_ADDRESS @MemoryAddress@Pwr_Lim@ /end MEASUREMENT
/begin MEASUREMENT Maxchange_Lim_T "" FLOAT32_IEEE E33_VCU_simulink_CM_single 0 0 -3.4E+38 3.4E+38 ECU_ADDRESS @MemoryAddress@Maxchange_Lim_T@ /end MEASUREMENT
/begin MEASUREMENT MCU_TorqCmd "" FLOAT32_IEEE E33_VCU_simulink_CM_single 0 0 -3.4E+38 3.4E+38 ECU_ADDRESS @MemoryAddress@MCU_TorqCmd@ /end MEASUREMENT
/begin MEASUREMENT MCU_SpdCmd "" FLOAT32_IEEE E33_VCU_simulink_CM_single 0 0 -3.4E+38 3.4E+38 ECU_ADDRESS @MemoryAddress@MCU_SpdCmd@ /end MEASUREMENT
/begin MEASUREMENT Wheel_Angle "" SLONG E33_VCU_simulink_CM_int32 0 0 -2147483648 2147483647 ECU_ADDRESS @MemoryAddress@Wheel_Angle@ /end MEASUREMENT
/begin MEASUREMENT McuInfoOfflineCnt "" ULONG E33_VCU_simulink_CM_uint32 0 0 0 0xFFFFFFFF ECU_ADDRESS @MemoryAddress@McuInfoOfflineCnt@ /end MEASUREMENT
/begin MEASUREMENT McuStatelineCnt "" ULONG E33_VCU_simulink_CM_uint32 0 0 0 0xFFFFFFFF ECU_ADDRESS @MemoryAddress@McuStatelineCnt@ /end MEASUREMENT
/begin MEASUREMENT APPS_Pos "" ULONG E33_VCU_simulink_CM_ufix32_En16 0 0 0 65535.999984741211 ECU_ADDRESS @MemoryAddress@APPS_Pos@ /end MEASUREMENT
/begin MEASUREMENT APPS1_PWR "" UWORD E33_VCU_simulink_CM_uint16 0 0 0 65535 ECU_ADDRESS @MemoryAddress@APPS1_PWR@ /end MEASUREMENT
/begin MEASUREMENT APPS2_PWR "" UWORD E33_VCU_simulink_CM_uint16 0 0 0 65535 ECU_ADDRESS @MemoryAddress@APPS2_PWR@ /end MEASUREMENT
/begin MEASUREMENT BP_PWR "" UWORD E33_VCU_simulink_CM_uint16 0 0 0 65535 ECU_ADDRESS @MemoryAddress@BP_PWR@ /end MEASUREMENT
/begin MEASUREMENT I_BAT "" UWORD E33_VCU_simulink_CM_uint16 0 0 0 65535 ECU_ADDRESS @MemoryAddress@I_BAT@ /end MEASUREMENT
/begin MEASUREMENT I_UBR "" UWORD E33_VCU_simulink_CM_uint16 0 0 0 65535 ECU_ADDRESS @MemoryAddress@I_UBR@ /end MEASUREMENT
/begin MEASUREMENT PWR_5V "" UWORD E33_VCU_simulink_CM_uint16 0 0 0 65535 ECU_ADDRESS @MemoryAddress@PWR_5V@ /end MEASUREMENT
/begin MEASUREMENT Linear_RR "" UWORD E33_VCU_simulink_CM_uint16 0 0 0 65535 ECU_ADDRESS @MemoryAddress@Linear_RR@ /end MEASUREMENT
/begin MEASUREMENT Linear_FR "" UWORD E33_VCU_simulink_CM_uint16 0 0 0 65535 ECU_ADDRESS @MemoryAddress@Linear_FR@ /end MEASUREMENT
/begin MEASUREMENT Linear_RL "" UWORD E33_VCU_simulink_CM_uint16 0 0 0 65535 ECU_ADDRESS @MemoryAddress@Linear_RL@ /end MEASUREMENT
/begin MEASUREMENT Linear_FL "" UWORD E33_VCU_simulink_CM_uint16 0 0 0 65535 ECU_ADDRESS @MemoryAddress@Linear_FL@ /end MEASUREMENT
/begin MEASUREMENT Angle_Vol "" UWORD E33_VCU_simulink_CM_uint16 0 0 0 65535 ECU_ADDRESS @MemoryAddress@Angle_Vol@ /end MEASUREMENT
/begin MEASUREMENT BP_R_Vol_In "" UWORD E33_VCU_simulink_CM_uint16 0 0 0 65535 ECU_ADDRESS @MemoryAddress@BP_R_Vol_In@ /end MEASUREMENT
/begin MEASUREMENT BP_R_Pos "" UWORD E33_VCU_simulink_CM_uint16 0 0 0 65535 ECU_ADDRESS @MemoryAddress@BP_R_Pos@ /end MEASUREMENT
/begin MEASUREMENT BP_F_Vol_In "" UWORD E33_VCU_simulink_CM_uint16 0 0 0 65535 ECU_ADDRESS @MemoryAddress@BP_F_Vol_In@ /end MEASUREMENT
/begin MEASUREMENT BP_F_Pos "" UWORD E33_VCU_simulink_CM_uint16 0 0 0 65535 ECU_ADDRESS @MemoryAddress@BP_F_Pos@ /end MEASUREMENT
/begin MEASUREMENT APPS1_Pos "" UWORD E33_VCU_simulink_CM_uint16 0 0 0 65535 ECU_ADDRESS @MemoryAddress@APPS1_Pos@ /end MEASUREMENT
/begin MEASUREMENT APPS2_Pos "" UWORD E33_VCU_simulink_CM_uint16 0 0 0 65535 ECU_ADDRESS @MemoryAddress@APPS2_Pos@ /end MEASUREMENT
/begin MEASUREMENT APPS1_Vol_In "" UWORD E33_VCU_simulink_CM_uint16 0 0 0 65535 ECU_ADDRESS @MemoryAddress@APPS1_Vol_In@ /end MEASUREMENT
/begin MEASUREMENT APPS2_Vol_In "" UWORD E33_VCU_simulink_CM_uint16 0 0 0 65535 ECU_ADDRESS @MemoryAddress@APPS2_Vol_In@ /end MEASUREMENT
/begin MEASUREMENT APPSUn_dif "" UWORD E33_VCU_simulink_CM_uint16 0 0 0 65535 ECU_ADDRESS @MemoryAddress@APPSUn_dif@ /end MEASUREMENT
/begin MEASUREMENT BP_Lim_T "" UWORD E33_VCU_simulink_CM_uint16 0 0 0 65535 ECU_ADDRESS @MemoryAddress@BP_Lim_T@ /end MEASUREMENT
/begin MEASUREMENT Dri_T_request "" UWORD E33_VCU_simulink_CM_uint16 0 0 0 65535 ECU_ADDRESS @MemoryAddress@Dri_T_request@ /end MEASUREMENT
/begin MEASUREMENT VCUMCUCANOKK "" UBYTE E33_VCU_simulink_CM_uint8 0 0 0 255 ECU_ADDRESS @MemoryAddress@VCUMCUCANOKK@ /end MEASUREMENT
/begin MEASUREMENT Infomation_OK "" UBYTE E33_VCU_simulink_CM_uint8 0 0 0 255 ECU_ADDRESS @MemoryAddress@Infomation_OK@ /end MEASUREMENT
/begin MEASUREMENT State_OK "" UBYTE E33_VCU_simulink_CM_uint8 0 0 0 255 ECU_ADDRESS @MemoryAddress@State_OK@ /end MEASUREMENT
/begin MEASUREMENT APPS_Unreliable "" UBYTE E33_VCU_simulink_CM_uint8 0 0 0 255 ECU_ADDRESS @MemoryAddress@APPS_Unreliable@ /end MEASUREMENT
/begin MEASUREMENT BMSInfoCnt "" UBYTE E33_VCU_simulink_CM_uint8 0 0 0 255 ECU_ADDRESS @MemoryAddress@BMSInfoCnt@ /end MEASUREMENT
/begin MEASUREMENT BMSALMCnt "" UBYTE E33_VCU_simulink_CM_uint8 0 0 0 255 ECU_ADDRESS @MemoryAddress@BMSALMCnt@ /end MEASUREMENT
/begin MEASUREMENT BMSMAXTCnt "" UBYTE E33_VCU_simulink_CM_uint8 0 0 0 255 ECU_ADDRESS @MemoryAddress@BMSMAXTCnt@ /end MEASUREMENT
/begin MEASUREMENT BMSMXVCnt "" UBYTE E33_VCU_simulink_CM_uint8 0 0 0 255 ECU_ADDRESS @MemoryAddress@BMSMXVCnt@ /end MEASUREMENT
/begin MEASUREMENT DCDC_ON "" UBYTE E33_VCU_simulink_CM_boolean 0 0 0 1 ECU_ADDRESS @MemoryAddress@DCDC_ON@ /end MEASUREMENT
/begin MEASUREMENT DCDC_MR "" UBYTE E33_VCU_simulink_CM_boolean 0 0 0 1 ECU_ADDRESS @MemoryAddress@DCDC_MR@ /end MEASUREMENT
/begin MEASUREMENT BmsLedStat "" UBYTE E33_VCU_simulink_CM_boolean 0 0 0 1 ECU_ADDRESS @MemoryAddress@BmsLedStat@ /end MEASUREMENT
/begin MEASUREMENT BeeperStat "" UBYTE E33_VCU_simulink_CM_boolean 0 0 0 1 ECU_ADDRESS @MemoryAddress@BeeperStat@ /end MEASUREMENT
/begin MEASUREMENT ImdLedStat "" UBYTE E33_VCU_simulink_CM_boolean 0 0 0 1 ECU_ADDRESS @MemoryAddress@ImdLedStat@ /end MEASUREMENT
/begin MEASUREMENT ReadyLEDstat "" UBYTE E33_VCU_simulink_CM_boolean 0 0 0 1 ECU_ADDRESS @MemoryAddress@ReadyLEDstat@ /end MEASUREMENT
/begin MEASUREMENT R2D_Light "" UBYTE E33_VCU_simulink_CM_boolean 0 0 0 1 ECU_ADDRESS @MemoryAddress@R2D_Light@ /end MEASUREMENT
/begin MEASUREMENT MCU_Online "" UBYTE E33_VCU_simulink_CM_boolean 0 0 0 1 ECU_ADDRESS @MemoryAddress@MCU_Online@ /end MEASUREMENT
/begin MEASUREMENT R2D_SW "" UBYTE E33_VCU_simulink_CM_boolean 0 0 0 1 ECU_ADDRESS @MemoryAddress@R2D_SW@ /end MEASUREMENT
/begin MEASUREMENT BP_F_Disconnect "" UBYTE E33_VCU_simulink_CM_boolean 0 0 0 1 ECU_ADDRESS @MemoryAddress@BP_F_Disconnect@ /end MEASUREMENT
/begin MEASUREMENT BP_R_Disconnect "" UBYTE E33_VCU_simulink_CM_boolean 0 0 0 1 ECU_ADDRESS @MemoryAddress@BP_R_Disconnect@ /end MEASUREMENT
/begin MEASUREMENT APPS1_Disconnect "" UBYTE E33_VCU_simulink_CM_boolean 0 0 0 1 ECU_ADDRESS @MemoryAddress@APPS1_Disconnect@ /end MEASUREMENT
/begin MEASUREMENT APPS2_Disconnect "" UBYTE E33_VCU_simulink_CM_boolean 0 0 0 1 ECU_ADDRESS @MemoryAddress@APPS2_Disconnect@ /end MEASUREMENT
/begin MEASUREMENT BMS_Online "" UBYTE E33_VCU_simulink_CM_boolean 0 0 0 1 ECU_ADDRESS @MemoryAddress@BMS_Online@ /end MEASUREMENT
/begin MEASUREMENT APPS_OK "" UBYTE E33_VCU_simulink_CM_boolean 0 0 0 1 ECU_ADDRESS @MemoryAddress@APPS_OK@ /end MEASUREMENT
/begin MEASUREMENT BP_F_OK "" UBYTE E33_VCU_simulink_CM_boolean 0 0 0 1 ECU_ADDRESS @MemoryAddress@BP_F_OK@ /end MEASUREMENT
/begin MEASUREMENT MCU_Ready "" UBYTE E33_VCU_simulink_CM_boolean 0 0 0 1 ECU_ADDRESS @MemoryAddress@MCU_Ready@ /end MEASUREMENT
/begin MEASUREMENT MCU_Cut "" UBYTE E33_VCU_simulink_CM_boolean 0 0 0 1 ECU_ADDRESS @MemoryAddress@MCU_Cut@ /end MEASUREMENT
/begin MEASUREMENT Bad_APPAlm "" UBYTE E33_VCU_simulink_CM_boolean 0 0 0 1 ECU_ADDRESS @MemoryAddress@Bad_APPAlm@ /end MEASUREMENT
/begin MEASUREMENT BadApp1Alm "" UBYTE E33_VCU_simulink_CM_boolean 0 0 0 1 ECU_ADDRESS @MemoryAddress@BadApp1Alm@ /end MEASUREMENT
/begin MEASUREMENT BadApp2Alm "" UBYTE E33_VCU_simulink_CM_boolean 0 0 0 1 ECU_ADDRESS @MemoryAddress@BadApp2Alm@ /end MEASUREMENT
/begin MEASUREMENT BadMcuAlm "" UBYTE E33_VCU_simulink_CM_boolean 0 0 0 1 ECU_ADDRESS @MemoryAddress@BadMcuAlm@ /end MEASUREMENT
/begin MEASUREMENT A_level_Warn "" UBYTE E33_VCU_simulink_CM_boolean 0 0 0 1 ECU_ADDRESS @MemoryAddress@A_level_Warn@ /end MEASUREMENT
/begin MEASUREMENT B_level_Warn "" UBYTE E33_VCU_simulink_CM_boolean 0 0 0 1 ECU_ADDRESS @MemoryAddress@B_level_Warn@ /end MEASUREMENT
/begin MEASUREMENT VehStandby "" UBYTE E33_VCU_simulink_CM_boolean 0 0 0 1 ECU_ADDRESS @MemoryAddress@VehStandby@ /end MEASUREMENT
/begin MEASUREMENT VehReady "" UBYTE E33_VCU_simulink_CM_boolean 0 0 0 1 ECU_ADDRESS @MemoryAddress@VehReady@ /end MEASUREMENT
/begin COMPU_METHOD E33_VCU_simulink_CM_uint16 "Q = V" RAT_FUNC "%5.0" "" COEFFS 0 1 0 0 0 1 /end COMPU_METHOD
/begin COMPU_METHOD E33_VCU_simulink_CM_double "Q = V" RAT_FUNC "%15.10" "" COEFFS 0 1 0 0 0 1 /end COMPU_METHOD
/begin COMPU_METHOD E33_VCU_simulink_CM_single "Q = V" RAT_FUNC "%8.6" "" COEFFS 0 1 0 0 0 1 /end COMPU_METHOD
/begin COMPU_METHOD E33_VCU_simulink_CM_uint32 "Q = V" RAT_FUNC "%10.0" "" COEFFS 0 1 0 0 0 1 /end COMPU_METHOD
/begin COMPU_METHOD E33_VCU_simulink_CM_ufix32_En16 "Q = V*65536.000000f" RAT_FUNC "%26.16" "" COEFFS 0 65536.000000f 0.000000f 0 0 1.000000f /end COMPU_METHOD
/begin COMPU_METHOD E33_VCU_simulink_CM_boolean "Q = V" RAT_FUNC "%1.0" "" COEFFS 0 1 0 0 0 1 /end COMPU_METHOD
/begin COMPU_METHOD E33_VCU_simulink_CM_int32 "Q = V" RAT_FUNC "%10.0" "" COEFFS 0 1 0 0 0 1 /end COMPU_METHOD
/begin COMPU_METHOD E33_VCU_simulink_CM_uint8 "Q = V" RAT_FUNC "%3.0" "" COEFFS 0 1 0 0 0 1 /end COMPU_METHOD
/begin GROUP E33_VCU_simulink "E33_VCU_simulink" /* Root */ ROOT /begin SUB_GROUP Root_Function_Call_Subsystem Root_Input Root_Subsystem1 /end SUB_GROUP /end GROUP
/begin GROUP Root_Function_Call_Subsystem "E33_VCU_simulink/Function-Call Subsystem" /begin SUB_GROUP S1_R2D_State S1_Veh_Dynamic S1_Warn /end SUB_GROUP /end GROUP
/begin GROUP Root_Input "E33_VCU_simulink/Input" /begin SUB_GROUP S2_Input /end SUB_GROUP /end GROUP
/begin GROUP Root_Subsystem1 "E33_VCU_simulink/Subsystem1" /begin SUB_GROUP S5_DCDC_Ctrl S5_MCUctrl S5_PanelCtrl /end SUB_GROUP /end GROUP
/begin GROUP S1_R2D_State "E33_VCU_simulink/Function-Call Subsystem/R2D_State" /begin REF_MEASUREMENT APPS_OK BP_F_OK MCU_Ready VehReady VehStandby /end REF_MEASUREMENT /end GROUP
/begin GROUP S1_Veh_Dynamic "E33_VCU_simulink/Function-Call Subsystem/Veh_Dynamic"
 /begin REF_MEASUREMENT BP_Lim_T Dri_T_request MCU_Cut MCU_SpdCmd MCU_TorqCmd Maxchange_Lim_T Pwr_Lim /end REF_MEASUREMENT
/end GROUP
/begin GROUP S1_Warn "E33_VCU_simulink/Function-Call Subsystem/Warn" /begin SUB_GROUP S8_A_level_Warn S8_B_level_Warn /end SUB_GROUP /end GROUP
/begin GROUP S2_Input "E33_VCU_simulink/Input/Input"
 /begin SUB_GROUP S23_APPS S23_BMS_CAN_Receive S23_Bpressure S23_Keys S23_MCU_CAN_Receive S23_Self_inspection S23_Sensor /end SUB_GROUP
/end GROUP
/begin GROUP S5_DCDC_Ctrl "E33_VCU_simulink/Subsystem1/DCDC_Ctrl" /begin REF_MEASUREMENT DCDC_MR DCDC_ON /end REF_MEASUREMENT /end GROUP
/begin GROUP S5_MCUctrl "E33_VCU_simulink/Subsystem1/MCUctrl" /begin SUB_GROUP S167_MCU_CMD_CAN_Tx /end SUB_GROUP /end GROUP
/begin GROUP S5_PanelCtrl "E33_VCU_simulink/Subsystem1/PanelCtrl" /begin REF_MEASUREMENT BeeperStat BmsLedStat ImdLedStat R2D_Light ReadyLEDstat /end REF_MEASUREMENT /end GROUP
/begin GROUP S8_A_level_Warn "E33_VCU_simulink/Function-Call Subsystem/Warn/A_level_Warn" /begin REF_MEASUREMENT A_level_Warn BadApp1Alm BadApp2Alm BadMcuAlm Bad_APPAlm /end REF_MEASUREMENT /end GROUP
/begin GROUP S8_B_level_Warn "E33_VCU_simulink/Function-Call Subsystem/Warn/B_level_Warn" /begin REF_MEASUREMENT B_level_Warn /end REF_MEASUREMENT /end GROUP
/begin GROUP S23_APPS "E33_VCU_simulink/Input/Input/APPS"
 /begin SUB_GROUP S24_Reliability_testing S24_SCS_Wire_breakage_detection S24_Subsystem /end SUB_GROUP
 /begin REF_MEASUREMENT APPS1_Pos APPS1_Vol_In APPS2_Pos APPS2_Vol_In /end REF_MEASUREMENT
/end GROUP
/begin GROUP S23_BMS_CAN_Receive "E33_VCU_simulink/Input/Input/BMS_CAN_Receive" /begin SUB_GROUP S25_BMS_INFO_Analyze S25_BMS_MAXT_Analyze /end SUB_GROUP /begin REF_MEASUREMENT BMSALMCnt BMSInfoCnt BMSMAXTCnt BMSMXVCnt BMS_Online /end REF_MEASUREMENT /end GROUP
/begin GROUP S23_Bpressure "E33_VCU_simulink/Input/Input/Bpressure" /begin SUB_GROUP S26_SCS_Wire_breakage_detection /end SUB_GROUP /begin REF_MEASUREMENT BP_F_Pos BP_F_Vol_In BP_R_Pos BP_R_Vol_In /end REF_MEASUREMENT /end GROUP
/begin GROUP S23_Keys "E33_VCU_simulink/Input/Input/Keys" /begin REF_MEASUREMENT R2D_SW /end REF_MEASUREMENT /end GROUP
/begin GROUP S23_MCU_CAN_Receive "E33_VCU_simulink/Input/Input/MCU_CAN_Receive" /begin SUB_GROUP S28_ReceiveMessages1 /end SUB_GROUP
 /begin REF_MEASUREMENT Infomation_OK MCU_Online McuInfoOfflineCnt McuStatelineCnt State_OK /end REF_MEASUREMENT
/end GROUP
/begin GROUP S23_Self_inspection "E33_VCU_simulink/Input/Input/Self_inspection" /begin REF_MEASUREMENT APPS1_PWR APPS2_PWR BP_PWR I_BAT I_UBR PWR_5V /end REF_MEASUREMENT /end GROUP
/begin GROUP S23_Sensor "E33_VCU_simulink/Input/Input/Sensor"
 /begin REF_MEASUREMENT Angle_Vol Linear_FL Linear_FR Linear_RL Linear_RR Wheel_Angle /end REF_MEASUREMENT
/end GROUP
/begin GROUP S167_MCU_CMD_CAN_Tx "E33_VCU_simulink/Subsystem1/MCUctrl/MCU_CMD_CAN_Tx" /begin REF_MEASUREMENT VCUMCUCANOKK /end REF_MEASUREMENT /end GROUP
/begin GROUP S24_Reliability_testing "E33_VCU_simulink/Input/Input/APPS/Reliability testing" /begin REF_MEASUREMENT APPSUn_dif APPS_Unreliable /end REF_MEASUREMENT /end GROUP
/begin GROUP S24_SCS_Wire_breakage_detection "E33_VCU_simulink/Input/Input/APPS/SCS_Wire_breakage_detection" /begin REF_MEASUREMENT APPS1_Disconnect APPS2_Disconnect /end REF_MEASUREMENT /end GROUP
/begin GROUP S24_Subsystem "E33_VCU_simulink/Input/Input/APPS/Subsystem" /begin REF_MEASUREMENT APPS_Pos /end REF_MEASUREMENT /end GROUP
/begin GROUP S25_BMS_INFO_Analyze "E33_VCU_simulink/Input/Input/BMS_CAN_Receive/BMS_INFO_Analyze" /begin SUB_GROUP S43_Enabled_Subsystem /end SUB_GROUP /end GROUP
/begin GROUP S25_BMS_MAXT_Analyze "E33_VCU_simulink/Input/Input/BMS_CAN_Receive/BMS_MAXT_Analyze" /begin SUB_GROUP S44_Enabled_Subsystem /end SUB_GROUP /end GROUP
/begin GROUP S26_SCS_Wire_breakage_detection "E33_VCU_simulink/Input/Input/Bpressure/SCS_Wire_breakage_detection" /begin REF_MEASUREMENT BP_F_Disconnect BP_R_Disconnect /end REF_MEASUREMENT /end GROUP
/begin GROUP S28_ReceiveMessages1 "E33_VCU_simulink/Input/Input/MCU_CAN_Receive/ReceiveMessages1" /begin SUB_GROUP S110_Enabled_Subsystem /end SUB_GROUP /end GROUP
/begin GROUP S43_Enabled_Subsystem "E33_VCU_simulink/Input/Input/BMS_CAN_Receive/BMS_INFO_Analyze/Enabled Subsystem" /begin REF_MEASUREMENT BMS_AlmLv BMS_Current BMS_SoC BMS_Voltage /end REF_MEASUREMENT /end GROUP
/begin GROUP S44_Enabled_Subsystem "E33_VCU_simulink/Input/Input/BMS_CAN_Receive/BMS_MAXT_Analyze/Enabled Subsystem" /begin REF_MEASUREMENT MaxTemp /end REF_MEASUREMENT /end GROUP
/begin GROUP S110_Enabled_Subsystem "E33_VCU_simulink/Input/Input/MCU_CAN_Receive/ReceiveMessages1/Enabled Subsystem" /begin REF_MEASUREMENT MCU_HvVolt /end REF_MEASUREMENT /end GROUP
/end MODULE
/end PROJECT
/* (add any file trailer comments here) */
/* EOF E33_VCU_simulink.a2l */
